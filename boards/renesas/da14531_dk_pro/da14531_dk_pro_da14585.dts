/dts-v1/;
#include <renesas/smartbond/da14585.dtsi>

/ {
	model = "DA1431 Development Kit Pro with DA14585 daughterboard";
	compatible = "renesas,da14531_dk_pro_da14585";
	#address-cells = <1>;
	#size-cells = <1>;

	chosen {
		zephyr,sram = &sram1;
		zephyr,code-partition = &sram1;
	};
};
