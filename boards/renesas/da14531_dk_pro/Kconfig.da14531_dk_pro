## boards/renesas/da14531_dk_pro/board.yml
```yaml
board:
  name: da14531_dk_pro
  full_name: DA14531 Development Kit Pro
  vendor: renesas
  socs:
  - name: da14585
  - name: da14586
```

## soc/renesas/smartbond/da1458x/Kconfig
```kconfig
config SOC_SERIES_DA1458X
	select ARM
	select CPU_CORTEX_M0
	select CPU_CORTEX_M_HAS_SYSTICK
	select HAS_SEGGER_RTT if ZEPHYR_SEGGER_MODULE
```

## soc/renesas/smartbond/da1458x/Kconfig.defconfig
```kconfig
if SOC_SERIES_DA1458X

config CORTEX_M_SYSTICK
	default y

config NUM_IRQS
	default 21

config XIP
	default n

config SYS_CLOCK_HW_CYCLES_PER_SEC
	default 100000000

endif # SOC_SERIES_DA1458X
```

## soc/renesas/smartbond/da1458x/Kconfig.soc
```kconfig
config SOC_SERIES_DA1458X
	bool
	select SOC_FAMILY_RENESAS_SMARTBOND
	help
	  Renesas SmartBond(tm) DA1458x series MCU

config SOC_DA14585
	bool
	select SOC_SERIES_DA1458X
	help
	  Renesas DA14585

config SOC_DA14586
	bool
	select SOC_SERIES_DA1458X
	help
	  Renesas DA14586

config SOC_SERIES
	default "da1458x" if SOC_SERIES_DA1458X

config SOC
	default "da14585" if SOC_DA14585
	default "da14586" if SOC_DA14586
```

## soc/renesas/smartbond/da145xx/Kconfig
```kconfig
config SOC_SERIES_DA145XX
	select ARM
	select CPU_CORTEX_M0
	select CPU_CORTEX_M_HAS_SYSTICK
	select HAS_SEGGER_RTT if ZEPHYR_SEGGER_MODULE
```

## soc/renesas/smartbond/da145xx/Kconfig.soc
```kconfig
config SOC_SERIES_DA145XX
	bool
	select SOC_FAMILY_RENESAS_SMARTBOND
	help
	  Renesas SmartBond(tm) DA145xx series MCU

config SOC_DA14531
	bool
	select SOC_SERIES_DA145XX
	help
	  Renesas DA14531

config SOC_DA14585
	bool
	select SOC_SERIES_DA145XX
	help
	  Renesas DA14585

config SOC_DA14586
	bool
	select SOC_SERIES_DA145XX
	help
	  Renesas DA14586

config SOC_SERIES
	default "da145xx" if SOC_SERIES_DA145XX

config SOC
	default "da14531" if SOC_DA14531
	default "da14585" if SOC_DA14585
	default "da14586" if SOC_DA14586
```
